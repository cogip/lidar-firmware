## Kconfig
```kconfig
#
# MCU firmware configuration
#
mainmenu "LIDAR firmware configuration"

menu "Platform configuration"

config ARCH
	string "Architecture"
	default "xmega"
	help
	  This can be xmega or unix.

choice
	prompt "Target"
	default LIDAR

config LIDAR
	bool "LIDAR"
	help
	  This will build the LIDAR firmware.

endchoice

config PLATFORM_NAME
	string
	default "lidar" if LIDAR

config CROSS_COMPILE
        string "Cross-compiler prefix"
        default "avr-"
        help
          Same as running 'make CROSS_COMPILE=prefix-' but stored for
          default make runs in this build directory.

config MCU
	string "MCU type"
	default "atxmega32a4" if LIDAR
	help
	  This define the argument to "-mcu" option while calling the
	  cross-compiler.

config F_CPU
	int "F_CPU (Hz)"
	default 32000000
	help
	  This define the micro-controller CPU frequency (default: 32 MHz).

endmenu # "Platform configuration"

config KOS_CHECK_STACKS
	bool "Task stacks integrity checks"
	default y
	help
	  Select this if you want the OS to include markers on top and bottom
	  positions of task stacks. This add a some runtime overhead while
	  scheduler is called to switch tasks context. Anyway, this is important
	  to detect stack overflow & dimension tasks stack accordingly.
	  If unsure, say Y.

source drivers/Kconfig
```
